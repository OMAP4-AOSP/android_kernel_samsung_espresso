## arch/arm/mach-omap2/Kconfig.sec
```kconfig
# arch/arm/mach-omap2/Kconfig.sec
#
# Copyright (C) 2011 Samsung Electronics Co, Ltd.
#
# This software is licensed under the terms of the GNU General Public
# License version 2, as published by the Free Software Foundation, and
# may be copied, distributed, and modified under those terms.
#
# This program is distributed in the hope that it will be useful,
# but WITHOUT ANY WARRANTY; without even the implied warranty of
# MERCHANTABILITY or FITNESS FOR A PARTICULAR PURPOSE.  See the
# GNU General Public License for more details.
#

config MACH_OMAP4_SAMSUNG
	bool "OMAP4 based Samsung Board"
	depends on ARCH_OMAP4
	select OMAP_PACKAGE_CBL
	select OMAP_PACKAGE_CBS
	select REGULATOR_FIXED_VOLTAGE
	default n

config MACH_OMAP4_ESPRESSO
	bool "Samsung Espresso / Espresso10 (Galaxy Tab 2) Board"
	default n
	select MACH_OMAP4_SAMSUNG
```
